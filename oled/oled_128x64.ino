#include <Wire.h>
#include <Adafruit_GFX.h>
#include <Adafruit_SSD1306.h>

#define SCREEN_WIDTH 128
#define SCREEN_HEIGHT 64
#define OLED_RESET    -1
#define SCREEN_ADDR   0x3C

Adafruit_SSD1306 display(SCREEN_WIDTH, SCREEN_HEIGHT, &Wire, OLED_RESET);

// 'pixel-clawd', 50x40px
const unsigned char epd_bitmap_pixel_clawd[] PROGMEM = {
    0xff, 0xff, 0xff, 0xff, 0xff, 0xff, 0xc0, 0xff, 0xff, 0xff, 0xff, 0xff, 0xff, 0xc0, 0xff, 0x00,
    0x00, 0x00, 0x00, 0x3f, 0xc0, 0xff, 0x00, 0x00, 0x00, 0x00, 0x3f, 0xc0, 0xff, 0x00, 0x00, 0x00,
    0x00, 0x3f, 0xc0, 0xff, 0x00, 0x00, 0x00, 0x00, 0x3f, 0xc0, 0xff, 0x00, 0x00, 0x00, 0x00, 0x3f,
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    0xc0, 0xff, 0xff, 0xff, 0xff, 0xff, 0xff, 0xc0
};

int  prevFive      = -1;
int  prevSeven     = -1;
long prevFiveSecs  = -1;
long prevSevenSecs = -1;

void setup() {
  Serial.begin(9600);

  if (!display.begin(SSD1306_SWITCHCAPVCC, SCREEN_ADDR)) {
    Serial.println("OLED init failed");
    while (1);
  }

  display.clearDisplay();
  display.setTextSize(1);
  display.setTextColor(SSD1306_WHITE);
  display.setCursor(0, 28);
  display.print("Waiting...");
  display.display();
}

void loop() {
  if (Serial.available()) {
    String line = Serial.readStringUntil('\n');
    line.trim();

    Serial.print("Received: ");
    Serial.println(line);

    int c1 = line.indexOf(',');
    int c2 = line.indexOf(',', c1 + 1);
    int c3 = line.indexOf(',', c2 + 1);
    if (c1 < 0) return;

    int  five      = line.substring(0, c1).toInt();
    int  seven     = line.substring(c1 + 1, c2 > 0 ? c2 : line.length()).toInt();
    long fiveSecs  = c2 > 0 ? line.substring(c2 + 1, c3 > 0 ? c3 : line.length()).toInt() : -1;
    long sevenSecs = c3 > 0 ? line.substring(c3 + 1).toInt() : -1;

    if (five != prevFive || seven != prevSeven ||
        fiveSecs != prevFiveSecs || sevenSecs != prevSevenSecs) {
      drawAll(five, seven, fiveSecs, sevenSecs);
      prevFive      = five;
      prevSeven     = seven;
      prevFiveSecs  = fiveSecs;
      prevSevenSecs = sevenSecs;
    }
  }
}

String formatTime(long secs) {
  if (secs <= 0) return "now";
  long h = secs / 3600;
  long m = (secs % 3600) / 60;
  char buf[12];
  if (h >= 24) {
    sprintf(buf, "%ldd%02ldh", h / 24, h % 24);
  } else {
    sprintf(buf, "%ldh%02ldm", h, m);
  }
  return String(buf);
}

void drawBar(int x, int y, int w, int h, int percent) {
  display.drawRect(x, y, w, h, SSD1306_WHITE);
  int filled = ((long)percent * (w - 2)) / 100;
  if (filled > 0) {
    display.fillRect(x + 1, y + 1, filled, h - 2, SSD1306_WHITE);
  }
}

void drawMetric(int y, const char* label, int pct, long secs) {
  char buf[6];
  display.setTextSize(1);
  display.setCursor(0, y);
  display.print(label);
  sprintf(buf, " %2d%%", pct);
  display.setCursor(12, y);
  display.print(buf);
  if (secs >= 0) {
    display.setCursor(44, y);
    display.print(formatTime(secs));
  }
  drawBar(0, y + 9, 75, 6, pct);
}

void drawAll(int five, int seven, long fiveSecs, long sevenSecs) {
  display.clearDisplay();

  // 標題 "Claude" size 2（左上，y=0-15）
  display.setTextSize(2);
  display.setTextColor(SSD1306_WHITE);
  display.setCursor(0, 0);
  display.print("Claude");

  // 圖片（右側 x=78, 垂直置中 y=12, 50×40）
  display.fillRect(78, 14, 50, 40, SSD1306_WHITE);
  display.drawBitmap(78, 14, epd_bitmap_pixel_clawd, 50, 40, SSD1306_BLACK);

  // 5H / 7D metrics（左側 75px 寬）
  drawMetric(20, "5H", five,  fiveSecs);
  drawMetric(39, "7D", seven, sevenSecs);

  display.display();
}
